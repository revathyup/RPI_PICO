/ { 
    aliases {
        btn1 = &mybtn;
    };

    buttons {
        compatible = "gpio-keys";
        mybtn: button_0 {
            gpios = <&gpio0 20 GPIO_ACTIVE_LOW>;
            label = "User Button";
        };
    };
};
